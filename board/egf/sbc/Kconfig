## board/egf/sbc/Kconfig
```kconfig
if TARGET_EGF_SBC_MX6ULZ

config SYS_BOARD
       default "egf_sbc_mxulz"

config SYS_VENDOR
       default "egf"

config SYS_CONFIG_NAME
       default "egf_sbc_mxulz"

endif

if TARGET_EGF_SBC_MX6UL

config SYS_BOARD
       default "egf_sbc_mxul"

config SYS_VENDOR
       default "egf"

config SYS_CONFIG_NAME
       default "egf_sbc_mxul"

endif

if TARGET_EGF_SBC_MX6ULL

config SYS_BOARD
       default "sbc"

config SYS_VENDOR
       default "egf"

config SYS_CONFIG_NAME
       default "egf_sbc_mx6"
       
config SYS_TEXT_BASE
    default 0x87800000       

endif
```

## board/freescale/egf_evb_mx6/Kconfig
```kconfig
if TARGET_MX6EGFEVB

config SYS_BOARD
	default "egf_evb_mx6"

config SYS_VENDOR
	default "freescale"

config SYS_SOC
	default "mx6"

config SYS_CONFIG_NAME
	default "egf_evb_mx6"

endif
```

## board/freescale/egf_evb_mx7/Kconfig
```kconfig
if TARGET_EGF_EVB_MX7

config SYS_BOARD
	default "egf_evb_mx7"

config SYS_VENDOR
	default "freescale"

config SYS_CONFIG_NAME
	default "egf_evb_mx7"

endif
```

## configs/egf_evb_mx6_mfg_wid0500ae0101_defconfig
```kconfig
CONFIG_SYS_EXTRA_OPTIONS="IMX_CONFIG=board/freescale/egf_evb_mx6/ddr_mx6/WID0500_AE01.01.cfg,MX6QDL,WID=\"WID0500_AE01.01\",SYS_BOOT_SPINOR"
CONFIG_ARM=y
CONFIG_TARGET_MX6EGFEVB=y
CONFIG_DM=y
CONFIG_DM_THERMAL=y 
```

## configs/egf_evb_mx6_mfg_wid0510ae0102_defconfig
```kconfig
CONFIG_SYS_EXTRA_OPTIONS="IMX_CONFIG=board/freescale/egf_evb_mx6/ddr_mx6/WID0510_AE01.02.cfg,MX6QDL,WID=\"WID0510_AE01.02\",SYS_BOOT_SPINOR"
CONFIG_ARM=y
CONFIG_TARGET_MX6EGFEVB=y
CONFIG_DM=y
CONFIG_DM_THERMAL=y 
```

## configs/egf_evb_mx6_spl_defconfig
```kconfig
CONFIG_SPL=y
CONFIG_SYS_EXTRA_OPTIONS="IMX_CONFIG=board/freescale/egf_evb_mx6/spl_spi.cfg,SPL,MX6QDL,SYS_BOOT_SPINOR"
CONFIG_ARM=y
CONFIG_TARGET_MX6EGFEVB=y
CONFIG_DM=y
CONFIG_DM_THERMAL=y
```

## configs/egf_evb_mx7_mfg_wid0575_aa0102_defconfig
```kconfig
CONFIG_ARM=y
CONFIG_ARCH_MX7=y
CONFIG_TARGET_EGF_EVB_MX7=y
CONFIG_IMX_RDC=y
CONFIG_IMX_BOOTAUX=y
CONFIG_SYS_EXTRA_OPTIONS="IMX_CONFIG=board/freescale/egf_evb_mx7/ddr_mx7/WID0575_AA01.02.cfg,WID=\"WID0575_AA01.02\",MX7D,SYS_BOOT_SPINOR"
CONFIG_CMD_GPIO=y
CONFIG_CMD_DHCP=y
CONFIG_CMD_PING=y
```

## configs/egf_sbc_mx6ull_mfg_wid0569_aa0101_defconfig
```kconfig
CONFIG_ARM=y
CONFIG_ARCH_MX6=y
CONFIG_TARGET_EGF_SBC_MX6ULL=y
CONFIG_SYS_EXTRA_OPTIONS="IMX_CONFIG=board/egf/sbc/ddr_mx6/WID0569_AA01.01.cfg,WID=\"WID0569_AA01.01\",SYS_BOOT_SPINOR"
CONFIG_CMD_GPIO=y
CONFIG_HUSH_PARSER=y
CONFIG_CONSOLE_EXTRA_INFO=y
CONFIG_VIDEO_LOGO=y

CONFIG_OF_LIBFDT=y
CONFIG_OF_SYSTEM_SETUP=y
CONFIG_OF_CONTROL=y

CONFIG_BOARD_LATE_INIT=y
CONFIG_DISPLAY_CPUINFO=y
CONFIG_DISPLAY_BOARDINFO=y
CONFIG_FS_FAT=y
CONFIG_FS_FAT_MAX_CLUSTSIZE=65536
CONFIG_DM_REGULATOR=y
```

## configs/egf_sbc_mx6ulz_spl_defconfig
```kconfig
CONFIG_ARM=y
CONFIG_ARCH_MX6=y
CONFIG_TARGET_EGF_SBC_MX6ULZ=y
CONFIG_SYS_EXTRA_OPTIONS="IMX_CONFIG=board/egf/sbc/spl_spi.cfg,SPL,SYS_BOOT_SPINOR"
CONFIG_CMD_GPIO=y
CONFIG_CMD_FDT=y
CONFIG_CMD_BMODE=y
CONFIG_OF_LIBFDT=y
CONFIG_OF_SYSTEM_SETUP=y
CONFIG_OF_CONTROL=y
CONFIG_MMC=y
CONFIG_BOARD_LATE_INIT=y
CONFIG_DISPLAY_CPUINFO=y
CONFIG_DISPLAY_BOARDINFO=y
CONFIG_FS_FAT=y
CONFIG_FS_FAT_MAX_CLUSTSIZE=65536
CONFIG_USB=y
CONFIG_DM_USB=y
CONFIG_DM_REGULATOR=y

CONFIG_SPL=y
CONFIG_SPL_GPIO_SUPPORT=y
CONFIG_SPL_LIBCOMMON_SUPPORT=y
CONFIG_SPL_LIBGENERIC_SUPPORT=y
CONFIG_SPL_SERIAL_SUPPORT=y
CONFIG_SPL_I2C_SUPPORT=y
CONFIG_SPL_WATCHDOG_SUPPORT=y
CONFIG_SPL_DMA_SUPPORT=y

CONFIG_SF_DEFAULT_BUS=1
CONFIG_SF_DEFAULT_CS=0
```
